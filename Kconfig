## Kconfig
```kconfig
menu "BarnaNetLibrary Menu"

	menu "TCP server"
		config B_TCP_PORT
			int "Server PORT"
			default 2005
			range 1 65535
			help
				The port number the TCP server binds to on all available interfaces.
	endmenu

	menu "Alarm"
		config B_ALARM_CONTAINER_CAPACITY
			int "Alarm container capacity"
			default 10
			range 1 255
			help
				The maximum storable alarm count.
	endmenu

	menu "Azure IoT Hub"
		config B_MQTT_DEVICE_ID
			string "MQTT Device ID"
			default ""
			help
				The device ID used for MQTT connection.
				Used as default device name in Device Admin component.
	endmenu

endmenu
 
```
